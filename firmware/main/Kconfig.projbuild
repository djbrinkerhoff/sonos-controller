## firmware/main/Kconfig.projbuild
```kconfig
menu "Tab5 screen"

config TAB5_DIM_SECONDS
    int "Dim the screen after this many idle seconds"
    default 60
    range 5 3600

config TAB5_OFF_SECONDS
    int "Turn the backlight off after this many idle seconds"
    default 180
    range 10 86400
    help
        Idle means no touch and no motion from the IMU. Music keeps playing;
        state polling pauses while the backlight is off.

config TAB5_DEEP_OFF_MINUTES
    int "Minutes after the backlight turns off before the display sleeps"
    default 10
    help
        Until then a tap wakes the screen. After it, the display stream stops
        (about 17 mA less) and only picking the device up wakes it: the touch
        controller shares the panel's chip and stops scanning.

config TAB5_STANDBY_MINUTES
    int "Minutes with the screen off and nothing playing before standby"
    # Standby also waits for the display to sleep (TAB5_DEEP_OFF_MINUTES).
    default 10
    help
        Standby stops Wi-Fi and light-sleeps until the device is picked up or
        touched; waking then takes a few seconds to rejoin the network. 0
        disables standby.

config TAB5_DIM_PERCENT
    int "Dimmed brightness percent"
    default 15
    range 1 100

config TAB5_DEFAULT_ROOM
    string "Room selected at startup"
    default ""
    help
        The room name exactly as the Sonos app shows it, for example
        "Kitchen". Empty, or not found, selects the first room.

config TAB5_START_VOLUME
    int "Volume for a favorite started in the startup room while it is idle"
    default 0
    range 0 100
    help
        Tapping a favorite while TAB5_DEFAULT_ROOM is not playing sets that
        room to this volume before playback starts. Music already playing
        is never changed. 0 leaves the volume alone.

config TAB5_SETTINGS_PASSCODE
    string "Passcode for changing Wi-Fi settings (four digits)"
    default "1234"
    help
        Settings shows the saved network read-only; Edit asks for this
        passcode before the Wi-Fi fields open. The build fails unless it is
        exactly four digits. With no network saved yet, the fields open
        without it.

endmenu

menu "Tab5 bring-up diagnostics"

config TAB5_I2C_SCAN
    bool "Run an I2C bus scan instead of starting the UI"
    default n
    help
        Enumerates every address on the BSP I2C bus under the same power
        sequence the display driver uses, then returns without initializing
        the panel. Used to identify the touch controller on hardware whose
        revision the board support package does not recognise.

        When enabled the device never starts the LVGL UI, so nothing appears
        on screen and the serial log is the only output.

config TAB5_FORGET_SPEAKERS
    bool "Forget stored speaker addresses at every boot"
    default n
    help
        Erases the manual speaker IP and the saved room IPs on each boot,
        so the controller must find a speaker through SSDP discovery.
        Wi-Fi credentials are kept. Used to test discovery
        on hardware; flash the normal build afterwards.

endmenu

menu "Tab5 power and motion"

config TAB5_MOTION_DPS
    int "Gyroscope magnitude that counts as motion (deg/s)"
    default 12
    range 1 2000
    help
        The BMI270 is polled at 25 Hz. A gyroscope vector magnitude above
        this threshold wakes the screen, debounced to at most one callback
        per 500 ms.

config TAB5_MOTION_MILLI_G
    int "Accelerometer delta that counts as motion (milli-g)"
    default 120
    range 1 16000
    help
        Wakes the screen when the accelerometer vector differs from a
        slow-moving baseline by more than this much, so gravity and a new
        resting orientation settle out instead of keeping the screen on.

config TAB5_MOTION_LOG
    bool "Log motion sensor maxima once per second"
    default n
    help
        Logs the largest gyroscope magnitude (deg/s) and accelerometer
        baseline delta (milli-g) seen each second, to calibrate
        TAB5_MOTION_DPS and TAB5_MOTION_MILLI_G on hardware.

endmenu
```
